/*
 * Walker Fall Detection Example
 * 
 * This example demonstrates real-time activity classification using a Random Forest
 * model trained to detect different human activities (idle, walking, motion, falling).
 * 
 * Features:
 * - Loads pre-trained Random Forest model from filesystem
 * - Performs predictions on 8 sample feature vectors (234 features each)
 * - Compares predictions against ground truth labels
 * - Calculates accuracy and timing metrics
 * - Supports actual label feedback for continuous learning
 * 
 * Hardware: ESP32 or compatible microcontroller with LittleFS support
 * Dataset: Walker fall detection with accelerometer/gyroscope features
 */

#define EML_DEV_STAGE    
#define RF_DEBUG_LEVEL 2
#define RF_USE_PSRAM

#include "random_forest_mcu.h"

const RfStorageType STORAGE_MODE = RfStorageType::SD_MMC_1BIT;

using namespace mcu;

void setup() {
    Serial.begin(115200);  
    while (!Serial);       // <-- Waits for Serial monitor to connect (important for USB CDC)

    Serial.println("\n╔════════════════════════════════════════════════════╗");
    Serial.println("║  Walker Fall Detection - Random Forest Example    ║");
    Serial.println("╚════════════════════════════════════════════════════╝\n");
    
    delay(1000);

    // Initialize filesystem
    Serial.print("💾 Initializing file system... ");
    if (!RF_FS_BEGIN(STORAGE_MODE)) {
        Serial.println("❌ FAILED!");
        Serial.println("⚠️  File system initialization failed. Cannot continue.");
        return;
    }
    Serial.println("✅ OK");
    
    manage_files();
    delay(500);
    
    long unsigned start_forest = mcu::platform::Rf_get_current_time(mcu::platform::TimeUnit::MILLISECONDS);
    
    // Initialize Random Forest model
    Serial.print("Loading model 'walker_fall'... ");
    const char* model_name = "walker_fall"; 
    RandomForest forest = RandomForest(model_name);
    
    // Optional: Configure forest parameters before training
    // forest.set_num_trees(20);
    // forest.set_random_seed(42);
    // forest.set_training_score(Rf_training_score::OOB_SCORE); 
    
    // Optional: Train or build model (commented out for pre-trained model)
    forest.build_model();
    long unsigned build_time = mcu::platform::Rf_get_current_time(mcu::platform::TimeUnit::MILLISECONDS);
    Serial.printf("Model built in %lu ms\n", build_time - start_forest);

    // forest.training(3);
    
    // Load pre-trained forest from filesystem
    long unsigned load_start = mcu::platform::Rf_get_current_time(mcu::platform::TimeUnit::MILLISECONDS);
    if (!forest.loadForest()) {
        Serial.println("❌ FAILED");
        return;
    }
    long unsigned load_end = mcu::platform::Rf_get_current_time(mcu::platform::TimeUnit::MILLISECONDS);
    Serial.printf("Forest loaded in %lu ms\n", load_end - load_start);

    // Optional: Enable dataset extension for online learning
    // forest.enable_extend_base_data();

    // simulate prediction in real-world 
    b_vector<float> sample_1 = MAKE_FLOAT_LIST(0,0,0,0,0,0,0,0,0,0,0,0,0,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1.4559,1.4666);
    b_vector<float> sample_2 = MAKE_FLOAT_LIST(-0.0008,0.0181,0.1298,0.1815,0.1867,0.0526,0.0188,0.0228,0.3152,0.3559,0.3647,0.4213,0.4188,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0.8011,0.8872);
    b_vector<float> sample_3 = MAKE_FLOAT_LIST(-0.0008,0.0181,0.1298,0.1815,0.1867,0.0526,0.0188,0.0228,0.3152,0.3559,0.3647,0.4213,0.4188,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0.8011,0.8872);

    vector<b_vector<float>> samples;
    samples.push_back(sample_1);
    samples.push_back(sample_2);
    samples.push_back(sample_3);

    // simulate label feedback
    vector<String> true_labels = MAKE_STRING_LIST("idle", "fall", "step");

    // Perform predictions on all samples
    unsigned long total_time = 0;
    uint8_t correct_predictions = 0;
    
    Serial.println("\n=== Prediction Results ===");
    Serial.println("Sample | Predicted | Actual   | Time (μs) | Match");
    Serial.println("-------|-----------|----------|-----------|------");
    
    for (int i = 0; i < samples.size(); i++){
        rf_predict_result_t result;
        forest.predict(samples[i], result);
        
        if (!result.success) {
            Serial.printf("  %d    | FAILED    |          |           | ✗\n", i+1);
            continue;
        }
        
        total_time += result.prediction_time;
        forest.add_actual_label(true_labels[i]);
        
        bool is_correct = (strcmp(result.label, true_labels[i].c_str()) == 0);
        const char* match = is_correct ? "✓" : "✗";
        if (is_correct) correct_predictions++;
        
        Serial.printf("  %d    | %-9s | %-8s | %9lu | %s\n", 
                     i+1, result.label, true_labels[i].c_str(), 
                     result.prediction_time, match);
    }
    
    Serial.println("-----------------------------------------------");
    Serial.printf("Total samples: %d\n", samples.size());
    Serial.printf("Correct predictions: %d/%d (%.1f%%)\n", 
                  correct_predictions, samples.size(), 
                  (correct_predictions * 100.0f) / samples.size());
    Serial.printf("Average prediction time: %lu μs\n", total_time / samples.size());
    Serial.println();
    
    // Clean up and compute statistics
    Serial.print("\nReleasing forest from memory... ");
    if (forest.releaseForest()) {
        Serial.println("✅ OK");
    } else {
        Serial.println("⚠️  WARNING: Release failed");
    }
    
    // Optional: Write pending data to dataset for retraining
    // forest.flush_pending_data();

    // Display inference statistics
    Serial.println("\n=== Model Performance Metrics ===");
    float p_score = forest.get_practical_inference_score();
    Serial.printf("Practical Inference Score: %.3f (%.1f%%)\n", p_score, p_score * 100.0f);
    
    int total_logged = forest.get_total_logged_inference();
    Serial.printf("Total Logged Inferences: %d\n", total_logged);

    long unsigned end_forest = mcu::platform::Rf_get_current_time(mcu::platform::TimeUnit::MILLISECONDS);
    Serial.println("\n=== Execution Summary ===");
    Serial.printf("Total execution time: %lu ms\n", end_forest - start_forest);
    Serial.println("\n✅ Example completed successfully!\n");
}

void loop() {
    // manage_files();
}